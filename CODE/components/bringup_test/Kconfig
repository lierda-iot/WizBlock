## CODE/examples/rc_tank_demo/main/Kconfig.projbuild
```kconfig
menu "RC Tank Demo Configuration"

    choice RC_TANK_ROLE
        prompt "Device Role"
        default RC_TANK_ROLE_TANK
        help
            Select the role for this device: Tank or Remote Controller.
            Tank: Runs motors, camera capture, video transmission, audio playback.
            Remote: Displays video, sends joystick commands, records audio.

        config RC_TANK_ROLE_TANK
            bool "Tank"
            help
                Tank role: Receives control commands, drives motors, captures and
                sends video stream, receives and plays audio.

        config RC_TANK_ROLE_REMOTE
            bool "Remote Controller"
            help
                Remote controller role: Displays video stream, sends control commands
                via touchscreen joystick, records and sends audio via SW3.
    endchoice

    config RC_TANK_STABLE_CAPTURE
        bool "Use verified staged-DVP capture in formal Tank firmware"
        depends on RC_TANK_ROLE_TANK
        default y
        help
            Uses the C16-verified 102400-byte staged DVP controller, direct
            GDMA-EOF block copy, per-frame capture pause, and fixed output-row
            repair in the formal Tank JPEG pipeline. The Tank LCD remains a
            status screen; camera pixels are sent only to the Remote.

    config RC_TANK_AUDIO_ENABLED
        bool "Enable RC Tank audio features"
        default n
        help
            Enables Tank audio playback and Remote recording/PTT.  Keep this
            disabled while image transport, display, and control are stabilized.

    config RC_TANK_STARTUP_DELAY_SEC
        int "Startup delay (seconds)"
        default 10
        range 0 60
        help
            Delay in seconds before main logic starts. Used to capture full boot logs.
            XCR-028 convention: 10 seconds.

endmenu
```

## CODE/examples/rc_tank_demo/sdkconfig.defaults
```kconfig
# 遥控坦克 Demo 公共默认配置 (design.md 2.2 / 13)
CONFIG_IDF_TARGET="esp32s3"
CONFIG_ESPTOOLPY_FLASHSIZE_8MB=y

# 分区表
CONFIG_PARTITION_TABLE_CUSTOM=y
CONFIG_PARTITION_TABLE_CUSTOM_FILENAME="partitions.csv"

# PSRAM: 大缓冲(JPEG/PCM/RGB565)分配用 (design.md 7.4/13)
CONFIG_SPIRAM=y
CONFIG_SPIRAM_MODE_QUAD=y
CONFIG_SPIRAM_SPEED_80M=y
CONFIG_SPIRAM_MALLOC_ALWAYSINTERNAL=2048
CONFIG_SPIRAM_MALLOC_RESERVE_INTERNAL=65536
CONFIG_SPIRAM_ALLOW_STACK_EXTERNAL_MEMORY=y

# WiFi: SoftAP(坦克) + STA(遥控器) 均需支持 (design.md 4.1)
CONFIG_ESP_WIFI_SOFTAP_SUPPORT=y
CONFIG_ESP_WIFI_DYNAMIC_TX_BUFFER_NUM=64

# 系统
CONFIG_FREERTOS_HZ=1000
CONFIG_ESP_DEFAULT_CPU_FREQ_MHZ_240=y
CONFIG_ESP_SYSTEM_EVENT_TASK_STACK_SIZE=4096
CONFIG_LWIP_TCPIP_RECVMBOX_SIZE=16

# 角色默认为坦克(Kconfig choice 默认 RC_TANK_ROLE_TANK)。
# 切换遥控器角色: 构建时设 SDKCONFIG_DEFAULTS="sdkconfig.defaults;sdkconfig.defaults.remote"
# 或 menuconfig 选择 Device Role。
```

## CODE/examples/rc_tank_demo/sdkconfig.defaults.remote
```kconfig
# Remote(遥控器) 角色配置片段
CONFIG_RC_TANK_ROLE_REMOTE=y
# CONFIG_RC_TANK_AUDIO_ENABLED is not set
CONFIG_LWIP_UDP_RECVMBOX_SIZE=16
```

## CODE/examples/rc_tank_demo/sdkconfig.defaults.tank
```kconfig
# Tank 角色配置片段
CONFIG_RC_TANK_ROLE_TANK=y
CONFIG_RC_TANK_STABLE_CAPTURE=y
# CONFIG_RC_TANK_AUDIO_ENABLED is not set
# CONFIG_ESP_WIFI_TASK_PINNED_TO_CORE_1 is not set
CONFIG_ESP_WIFI_TASK_PINNED_TO_CORE_0=y
# CONFIG_ESP_WIFI_EXTRA_IRAM_OPT is not set
# CONFIG_CAM_CTLR_DVP_CAM_ISR_CACHE_SAFE is not set
CONFIG_CAM_CTRL_DVP_ENABLE=y
CONFIG_CAM_CTRL_DVP_DMA_BUFFER_SIZE=32768
# CONFIG_CAM_CTRL_DVP_LOG_ENABLE is not set
```

## CODE/examples/touch_2048_demo/main/Kconfig.projbuild
```kconfig
menu "Touch 2048 Demo"

choice TOUCH_2048_LCD_PIXEL_CLOCK
    prompt "LCD SPI pixel clock"
    default TOUCH_2048_LCD_PIXEL_CLOCK_40MHZ
    help
        Keep 40 MHz for the validated fast path. Select 20 MHz only if the
        target display fails the 40 MHz stability gate.

    config TOUCH_2048_LCD_PIXEL_CLOCK_40MHZ
        bool "40 MHz"

    config TOUCH_2048_LCD_PIXEL_CLOCK_20MHZ
        bool "20 MHz compatibility fallback"
endchoice

endmenu
```

## CODE/examples/xiaozhi_ai_demo/main/Kconfig.projbuild
```kconfig
menu "XiaoZhi AI Demo Configuration"

    config XIAOZHI_DEVICE_MAC
        string "Device MAC address"
        default "2e:ee:8c:6b:58:28"
        help
            MAC address used for device identification on XiaoZhi platform.

    config XIAOZHI_OTA_URL
        string "OTA/Version check URL"
        default "https://api.tenclass.net/xiaozhi/ota/"
        help
            Server URL for version check and WebSocket endpoint discovery.

    config XIAOZHI_ACTIVATION_URL
        string "Activation check URL"
        default "https://api.tenclass.net/xiaozhi/ota/activate"
        help
            Server URL for device activation.

    config XIAOZHI_LANG
        string "Language setting"
        default "zh-CN"
        help
            Language for TTS and STT.

endmenu
```

## CODE/examples/xiaozhi_ai_demo/sdkconfig.defaults
```kconfig
CONFIG_IDF_TARGET="esp32s3"
CONFIG_XIAOZHI_DEVICE_MAC="2e:ee:8c:6b:58:28"
CONFIG_ESPTOOLPY_FLASHSIZE_8MB=y
CONFIG_PARTITION_TABLE_CUSTOM=y
CONFIG_PARTITION_TABLE_CUSTOM_FILENAME="partitions.csv"
CONFIG_SPIRAM=y
CONFIG_SPIRAM_MODE_QUAD=y
CONFIG_SPIRAM_SPEED_80M=y
CONFIG_SPIRAM_MALLOC_ALWAYSINTERNAL=2048
CONFIG_SPIRAM_MALLOC_RESERVE_INTERNAL=65536
CONFIG_SPIRAM_ALLOW_STACK_EXTERNAL_MEMORY=y
CONFIG_ESP_WIFI_SOFTAP_SUPPORT=n
CONFIG_FREERTOS_HZ=1000
CONFIG_ESP_SYSTEM_EVENT_TASK_STACK_SIZE=4096
CONFIG_LWIP_TCPIP_RECVMBOX_SIZE=16
CONFIG_WEBSOCKET_CLIENT_TASK_STACK_SIZE=6144
CONFIG_SR_WN_WN9S_NIHAOXIAOZHI=y
CONFIG_SR_NSN_NSNET2=y
CONFIG_MODEL_IN_SPIFFS=y
CONFIG_MODEL_IN_FLASH=n
CONFIG_MBEDTLS_CERTIFICATE_BUNDLE=y
CONFIG_MBEDTLS_CERTIFICATE_BUNDLE_DEFAULT_FULL=y
```

## CODE/examples/xiaozhi_companion_robot_demo/main/Kconfig.projbuild
```kconfig
menu "XiaoZhi Companion Robot Demo Configuration"

    config XIAOZHI_COMPANION_SELF_TEST
        bool "Run companion core self-test at startup"
        default n
        help
            Runs the DEV-0 public contract tests before the normal heartbeat.
            Keep disabled in the default product configuration.

    config XIAOZHI_DEVICE_MAC
        string "Device MAC address"
        default "2e:ee:8c:6b:58:28"
        help
            MAC address reserved for the later XiaoZhi platform adapter.

    config XIAOZHI_OTA_URL
        string "OTA/Version check URL"
        default "https://api.tenclass.net/xiaozhi/ota/"

    config XIAOZHI_ACTIVATION_URL
        string "Activation check URL"
        default "https://api.tenclass.net/xiaozhi/ota/activate"

    config XIAOZHI_LANG
        string "Language setting"
        default "zh-CN"

endmenu
```

## CODE/examples/xiaozhi_companion_robot_demo/sdkconfig.defaults
```kconfig
CONFIG_IDF_TARGET="esp32s3"
CONFIG_XIAOZHI_DEVICE_MAC="2e:ee:8c:6b:58:28"
CONFIG_ESPTOOLPY_FLASHSIZE_8MB=y
CONFIG_PARTITION_TABLE_CUSTOM=y
CONFIG_PARTITION_TABLE_CUSTOM_FILENAME="partitions.csv"
CONFIG_SPIRAM=y
CONFIG_SPIRAM_MODE_QUAD=y
CONFIG_SPIRAM_SPEED_80M=y
CONFIG_SPIRAM_MALLOC_ALWAYSINTERNAL=2048
CONFIG_SPIRAM_MALLOC_RESERVE_INTERNAL=65536
CONFIG_FREERTOS_TASK_CREATE_ALLOW_EXT_MEM=y
CONFIG_ESP_WIFI_SOFTAP_SUPPORT=n
CONFIG_FREERTOS_HZ=1000
CONFIG_ESP_SYSTEM_EVENT_TASK_STACK_SIZE=4096
CONFIG_LWIP_TCPIP_RECVMBOX_SIZE=16
CONFIG_WEBSOCKET_CLIENT_TASK_STACK_SIZE=6144
CONFIG_SR_WN_WN9S_NIHAOXIAOZHI=y
CONFIG_SR_NSN_NSNET2=y
CONFIG_MODEL_IN_SPIFFS=y
CONFIG_MODEL_IN_FLASH=n
CONFIG_MBEDTLS_CERTIFICATE_BUNDLE=y
CONFIG_MBEDTLS_CERTIFICATE_BUNDLE_DEFAULT_FULL=y
CONFIG_MBEDTLS_EXTERNAL_MEM_ALLOC=y
CONFIG_LV_USE_SPAN=y
CONFIG_NETWORK_MANAGER_ENABLE=y
CONFIG_NETWORK_MANAGER_TASK_STACK_IN_PSRAM=y
CONFIG_ESP_NETIF_IP_LOST_TIMER_INTERVAL=5
```

## CODE/sdkconfig.defaults
```kconfig
CONFIG_IDF_TARGET="esp32s3"
CONFIG_ESPTOOLPY_FLASHSIZE_8MB=y
CONFIG_PARTITION_TABLE_CUSTOM=y
CONFIG_PARTITION_TABLE_CUSTOM_FILENAME="partitions.csv"

CONFIG_ESP_DEFAULT_CPU_FREQ_MHZ_240=y
CONFIG_MODEL_IN_SPIFFS=y
CONFIG_SR_MN_NONE=y

CONFIG_LAIWFS300_BRINGUP_TEST_LOG_TASK=y
CONFIG_LAIWFS300_BRINGUP_TEST_LOG_PERIOD_MS=2000
CONFIG_LAIWFS300_ENABLE_MOTOR_SMOKE_TEST=y
CONFIG_LAIWFS300_MOTOR_SMOKE_TEST_DRY_RUN=n
CONFIG_LAIWFS300_ENABLE_DISPLAY_COLOR_TEST=y
CONFIG_LAIWFS300_ENABLE_CAMERA_PREVIEW_TEST=n

CONFIG_LAIWFS300_ENABLE_TOUCH_TEST=y
CONFIG_LAIWFS300_ENABLE_RTC_TEST=n
CONFIG_LAIWFS300_ENABLE_IMU_TEST=y
CONFIG_LAIWFS300_ENABLE_IOEX_INPUT_TEST=y
CONFIG_LAIWFS300_ENABLE_AUDIO_LOOPBACK_TEST=y

CONFIG_LAIWFS300_ENABLE_LTE_NET_TEST=y
CONFIG_LAIWFS300_LTE_NET_TEST_WIFI_SSID="lierda-guest"
CONFIG_LAIWFS300_LTE_NET_TEST_WIFI_PASSWORD="lsd920249"

CONFIG_SPIRAM=y
CONFIG_SPIRAM_MODE_QUAD=y
CONFIG_SPIRAM_SPEED_80M=y

CONFIG_ESP_WIFI_SOFTAP_SUPPORT=n
```
