## CODE/components/bringup_test/Kconfig
```kconfig
menu "LAIWFS300 bring-up test options"

config LAIWFS300_BRINGUP_TEST_LOG_TASK
    bool "Enable continuous bring-up status logs"
    default y
    help
        Periodically logs a small heartbeat so manual serial monitoring can prove
        the firmware is running after reset.

config LAIWFS300_BRINGUP_TEST_LOG_PERIOD_MS
    int "Bring-up status log period ms"
    depends on LAIWFS300_BRINGUP_TEST_LOG_TASK
    default 2000
    range 500 60000

config LAIWFS300_ENABLE_MOTOR_SMOKE_TEST
    bool "Enable motor smoke test (100% forward)"
    default y
    help
        Enables the motor forward test. Drives both tracks at 100% forward
        indefinitely. Keep disabled if motor hardware is not connected.

config LAIWFS300_MOTOR_SMOKE_TEST_DRY_RUN
    bool "Run motor smoke test in dry-run mode"
    depends on LAIWFS300_ENABLE_MOTOR_SMOKE_TEST
    default n
    help
        Logs the motor commands without driving GPIO/LEDC outputs.

config LAIWFS300_ENABLE_DISPLAY_COLOR_TEST
    bool "Enable display white/red color test"
    default y
    help
        Initializes the 2.4 inch ST7789V3 display and alternates full-screen
        white/red frames so manual bring-up can confirm the screen is working.

config LAIWFS300_DISPLAY_COLOR_TEST_PERIOD_MS
    int "Display color test period ms"
    depends on LAIWFS300_ENABLE_DISPLAY_COLOR_TEST
    default 1000
    range 200 60000

config LAIWFS300_ENABLE_CAMERA_PREVIEW_TEST
    bool "Enable camera preview test (capture to LCD every 10s)"
    default n
    help
        Initializes SP0A39 camera via DVP and displays a captured frame on
        the LCD every 10 seconds. Requires I2C bus, IO expander, camera board
        and display board connected.

config LAIWFS300_ENABLE_TOUCH_TEST
    bool "Enable touch IC bring-up test"
    default y
    help
        Initializes FT6206 touch IC, reads chip ID, and periodically polls
        touch events to verify the touch panel is responding.

config LAIWFS300_TOUCH_TEST_POLL_MS
    int "Touch test poll period ms"
    depends on LAIWFS300_ENABLE_TOUCH_TEST
    default 500
    range 100 10000

config LAIWFS300_ENABLE_RTC_TEST
    bool "Enable AIP8563 RTC test"
    default y
    help
        Sets RTC time and reads back after delay to verify counting.

config LAIWFS300_ENABLE_IMU_TEST
    bool "Enable BMI260 IMU test"
    default y
    help
        Reads accelerometer and gyroscope data from BMI260.

config LAIWFS300_ENABLE_AUDIO_TONE_TEST
    bool "Enable ES8311 1kHz tone test"
    default n
    help
        Plays a 1kHz sine wave through the speaker for 3 seconds.
        Requires speaker connected and AMP_CTRL available via IOEX.

config LAIWFS300_ENABLE_MIC_TEST
    bool "Enable ES7210 MIC RMS test"
    default n
    help
        Records audio from MIC and prints RMS level.

config LAIWFS300_ENABLE_AUDIO_LOOPBACK_TEST
    bool "Enable audio record-play test (record 10s then play 10s)"
    default n
    depends on !LAIWFS300_ENABLE_AUDIO_NS_TEST
    help
        Records 10 seconds of audio from MIC into PSRAM, then plays it back
        through the speaker. A beep tone signals recording start and end.
        Requires speaker and MIC board connected.

config LAIWFS300_ENABLE_AUDIO_NS_TEST
    bool "Enable audio NS denoise test (record 10s, play raw vs denoised)"
    default y
    help
        Records 10 seconds, processes through ESP AFE NSNet noise suppression,
        then plays both raw and denoised versions for comparison.
        Requires speaker, MIC board, and PSRAM.

config LAIWFS300_ENABLE_IOEX_INPUT_TEST
    bool "Enable IOEX input pin read test"
    default y
    help
        Reads TP_INT, TF_CD, RTC_INT input pins from TPT29555A.

config LAIWFS300_ENABLE_LTE_NET_TEST
    bool "Enable LTE/4G network test"
    default n
    help
        Powers on LTE module via IOEX P1_1, initializes lsd_net_mgmt with
        WiFi+4G dual-network management, and periodically logs network status.
        Requires SIM card inserted and LTE antenna connected.

config LAIWFS300_LTE_NET_TEST_WIFI_SSID
    string "WiFi SSID for LTE net test"
    depends on LAIWFS300_ENABLE_LTE_NET_TEST
    default "test_wifi"

config LAIWFS300_LTE_NET_TEST_WIFI_PASSWORD
    string "WiFi password for LTE net test"
    depends on LAIWFS300_ENABLE_LTE_NET_TEST
    default "12345678"

endmenu
```

## CODE/components/network_manager/Kconfig
```kconfig
menu "Network Manager"

config NETWORK_MANAGER_ENABLE
    bool "Enable network manager"
    default n

choice NETWORK_MANAGER_DEFAULT_MODE
    prompt "Default network mode"
    depends on NETWORK_MANAGER_ENABLE
    default NETWORK_MANAGER_DEFAULT_4G_ONLY

config NETWORK_MANAGER_DEFAULT_WIFI_ONLY
    bool "Wi-Fi only"

config NETWORK_MANAGER_DEFAULT_4G_ONLY
    bool "4G only"

config NETWORK_MANAGER_DEFAULT_DUAL_AUTO
    bool "Wi-Fi preferred / 4G fallback"

endchoice

config NETWORK_MANAGER_INITIAL_ATTEMPT_TIMEOUT_MS
    int "Initial LTE manager barrier timeout (ms)"
    depends on NETWORK_MANAGER_ENABLE
    range 0 60000
    default 6000
    help
        Maximum time network_manager_start() waits for the one-shot LTE
        power-on and manager initialization attempt. A timeout does not stop
        the worker; startup continues asynchronously.

config NETWORK_MANAGER_WIFI_CONNECT_STABLE_MS
    int "Wi-Fi connect stable window (ms)"
    depends on NETWORK_MANAGER_ENABLE
    range 1 600000
    default 10000
    help
        Continuous raw link, IPv4, and internet-ready time required before
        Wi-Fi becomes stable-ready. The same window resets its retry budget.

config NETWORK_MANAGER_WIFI_DISCONNECT_STABLE_MS
    int "Wi-Fi disconnect stable window (ms)"
    depends on NETWORK_MANAGER_ENABLE
    range 1 600000
    default 3000
    help
        Continuous raw Wi-Fi link/IP loss required before the stable state is
        cleared. Raw state and routing notifications remain immediate.

config NETWORK_MANAGER_WIFI_RETRY_LIMIT
    int "Wi-Fi automatic retry limit"
    depends on NETWORK_MANAGER_ENABLE
    range 1 255
    default 10
    help
        Maximum automatic Wi-Fi reconnect attempts in one retry cycle.
        Applying a valid configuration or requesting reconnect starts a new
        cycle.

config NETWORK_MANAGER_WIFI_RETRY_UNLIMITED
    bool "Keep retrying Wi-Fi after the retry limit"
    depends on NETWORK_MANAGER_ENABLE
    default n
    help
        Continue automatic Wi-Fi reconnects after the configured retry limit.
        The attempt counter saturates at 255 and the retry_exhausted state is
        never entered. Manual offline still suppresses all automatic retries.

config NETWORK_MANAGER_WIFI_RETRY_INITIAL_BACKOFF_MS
    int "Wi-Fi retry initial backoff (ms)"
    depends on NETWORK_MANAGER_ENABLE
    range 1 600000
    default 1000
    help
        Delay before the first automatic Wi-Fi retry. Later delays double
        until the configured maximum is reached.

config NETWORK_MANAGER_WIFI_RETRY_MAX_BACKOFF_MS
    int "Wi-Fi retry maximum backoff (ms)"
    depends on NETWORK_MANAGER_ENABLE
    range 1 600000
    default 30000
    help
        Upper bound for automatic Wi-Fi retry delay. If it is below the
        initial delay, the maximum is used from the first retry.

config NETWORK_MANAGER_CELLULAR_INITIAL_IPV4_WAIT_MS
    int "Initial cellular IPv4 wait (ms)"
    depends on NETWORK_MANAGER_ENABLE
    range 1 600000
    default 20000
    help
        IPv4 observation window after the one-shot LTE manager initialization.
        Expiry reports a fault but does not start an LTE power cycle.

config NETWORK_MANAGER_CELLULAR_POWER_OFF_HOLD_MS
    int "Cellular power-off hold (ms)"
    depends on NETWORK_MANAGER_ENABLE
    range 1 600000
    default 1000
    help
        LTE power-off hold used only by the explicit reconnect operation before
        LTE is powered on again. Cellular state observation never uses it.

config NETWORK_MANAGER_TASK_STACK_IN_PSRAM
    bool "Allocate network manager task stacks in PSRAM"
    depends on NETWORK_MANAGER_ENABLE && FREERTOS_TASK_CREATE_ALLOW_EXT_MEM
    default n
    help
        When enabled, worker and dispatcher task stacks (~10KB total) are
        allocated from external PSRAM instead of internal DRAM. Reduces
        internal memory pressure but requires CONFIG_FREERTOS_TASK_CREATE_ALLOW_EXT_MEM.
        Leave disabled if PSRAM stack support is not available or if internal
        RAM allocation is preferred for performance reasons.

endmenu
```

## CODE/components/network_manager/tests/idf_project/sdkconfig.defaults
```kconfig
CONFIG_IDF_TARGET="esp32s3"
CONFIG_NETWORK_MANAGER_ENABLE=y
CONFIG_NETWORK_MANAGER_DEFAULT_DUAL_AUTO=y
CONFIG_ESP_NETIF_IP_LOST_TIMER_INTERVAL=5
```

## CODE/examples/audio_aec_test/sdkconfig.defaults
```kconfig
CONFIG_IDF_TARGET="esp32s3"
CONFIG_ESPTOOLPY_FLASHSIZE_8MB=y
CONFIG_PARTITION_TABLE_CUSTOM=y
CONFIG_PARTITION_TABLE_CUSTOM_FILENAME="../../partitions.csv"
CONFIG_ESP_DEFAULT_CPU_FREQ_MHZ_240=y
CONFIG_MODEL_IN_SPIFFS=y
CONFIG_SR_MN_NONE=y
CONFIG_SR_WN_WN9S_NIHAOXIAOZHI=y
CONFIG_SR_NSN_NSNET2=y
CONFIG_ESP32S3_SPIRAM_SUPPORT=y
CONFIG_SPIRAM_MODE_QUAD=y
CONFIG_SPIRAM_SPEED_80M=y
CONFIG_ESP_MAIN_TASK_STACK_SIZE=8192
CONFIG_LV_FONT_MONTSERRAT_20=y
CONFIG_LV_FONT_MONTSERRAT_32=y
```

## CODE/examples/audio_ofdm_text_demo/sdkconfig.defaults
```kconfig
CONFIG_IDF_TARGET="esp32s3"
CONFIG_ESPTOOLPY_FLASHSIZE_8MB=y
CONFIG_PARTITION_TABLE_CUSTOM=y
CONFIG_PARTITION_TABLE_CUSTOM_FILENAME="partitions.csv"

CONFIG_ESP_DEFAULT_CPU_FREQ_MHZ_240=y
CONFIG_SPIRAM=y
CONFIG_SPIRAM_MODE_QUAD=y
CONFIG_SPIRAM_SPEED_80M=y
CONFIG_ESP_MAIN_TASK_STACK_SIZE=8192
CONFIG_COMPILER_OPTIMIZATION_PERF=y
CONFIG_FREERTOS_HZ=1000
CONFIG_FREERTOS_TASK_CREATE_ALLOW_EXT_MEM=y

CONFIG_LV_FONT_MONTSERRAT_12=y
CONFIG_LV_FONT_MONTSERRAT_16=y
CONFIG_LV_FONT_MONTSERRAT_20=y
```

## CODE/examples/codex_task_notifier_demo/sdkconfig.defaults
```kconfig
CONFIG_IDF_TARGET="esp32s3"
CONFIG_ESPTOOLPY_FLASHSIZE_8MB=y
CONFIG_PARTITION_TABLE_CUSTOM=y
CONFIG_PARTITION_TABLE_CUSTOM_FILENAME="partitions.csv"
CONFIG_SPIRAM=y
CONFIG_SPIRAM_MODE_QUAD=y
CONFIG_SPIRAM_SPEED_80M=y
CONFIG_ESP_WIFI_SOFTAP_SUPPORT=n
CONFIG_LV_FONT_MONTSERRAT_10=y
CONFIG_LV_FONT_MONTSERRAT_12=y
CONFIG_LV_FONT_MONTSERRAT_14=y
CONFIG_LV_FONT_MONTSERRAT_28=y
```

## CODE/examples/holocubic_demo/sdkconfig.defaults
```kconfig
CONFIG_IDF_TARGET="esp32s3"
CONFIG_ESPTOOLPY_FLASHSIZE_8MB=y
CONFIG_PARTITION_TABLE_CUSTOM=y
CONFIG_PARTITION_TABLE_CUSTOM_FILENAME="partitions.csv"
CONFIG_SPIRAM=y
CONFIG_SPIRAM_MODE_QUAD=y
CONFIG_SPIRAM_SPEED_80M=y
CONFIG_FREERTOS_TASK_CREATE_ALLOW_EXT_MEM=y
CONFIG_MBEDTLS_LARGE_KEY_SOFTWARE_MPI=y
CONFIG_MBEDTLS_EXTERNAL_MEM_ALLOC=y
CONFIG_NETWORK_MANAGER_ENABLE=y
CONFIG_NETWORK_MANAGER_DEFAULT_4G_ONLY=y
CONFIG_NETWORK_MANAGER_TASK_STACK_IN_PSRAM=n
```

## CODE/examples/integrated_demo/sdkconfig.defaults
```kconfig
CONFIG_IDF_TARGET="esp32s3"
CONFIG_ESPTOOLPY_FLASHSIZE_8MB=y
CONFIG_PARTITION_TABLE_SINGLE_APP=y

CONFIG_LAIWFS300_BRINGUP_TEST_LOG_TASK=y
CONFIG_LAIWFS300_BRINGUP_TEST_LOG_PERIOD_MS=2000
CONFIG_LAIWFS300_ENABLE_MOTOR_SMOKE_TEST=y
CONFIG_LAIWFS300_MOTOR_SMOKE_TEST_DRY_RUN=n
CONFIG_LAIWFS300_ENABLE_DISPLAY_COLOR_TEST=y
CONFIG_LAIWFS300_ENABLE_CAMERA_PREVIEW_TEST=n

CONFIG_LAIWFS300_ENABLE_TOUCH_TEST=y
CONFIG_LAIWFS300_ENABLE_RTC_TEST=y
CONFIG_LAIWFS300_ENABLE_IMU_TEST=y
CONFIG_LAIWFS300_ENABLE_IOEX_INPUT_TEST=y
CONFIG_LAIWFS300_ENABLE_AUDIO_LOOPBACK_TEST=y

CONFIG_LAIWFS300_ENABLE_LTE_NET_TEST=n

CONFIG_SPIRAM=y
CONFIG_SPIRAM_MODE_QUAD=y
CONFIG_SPIRAM_SPEED_80M=y
```

## CODE/examples/lte_net_demo/main/Kconfig.projbuild
```kconfig
menu "LTE Net Demo Configuration"

    choice DEMO_NETWORK_MODE
        prompt "Network mode"
        default DEMO_NETWORK_MODE_DUAL
        help
            Select the network mode for this demo.

        config DEMO_NETWORK_MODE_WIFI_ONLY
            bool "WiFi only"
            help
                Use WiFi as the sole network interface.

        config DEMO_NETWORK_MODE_4G_ONLY
            bool "4G only"
            help
                Use 4G/LTE as the sole network interface.

        config DEMO_NETWORK_MODE_DUAL
            bool "Dual network (WiFi + 4G)"
            help
                Use both WiFi and 4G with automatic failover.
    endchoice

    config DEMO_DEFAULT_WIFI_SSID
        string "Default WiFi SSID"
        default "lierda-guest"
        help
            Default WiFi SSID used when no saved config exists.

    config DEMO_DEFAULT_WIFI_PASSWORD
        string "Default WiFi password"
        default "lsd920249"
        help
            Default WiFi password used when no saved config exists.

endmenu
```

## CODE/examples/mp3_demo/sdkconfig.defaults
```kconfig
CONFIG_IDF_TARGET="esp32s3"
CONFIG_ESPTOOLPY_FLASHSIZE_8MB=y
CONFIG_PARTITION_TABLE_CUSTOM=y
CONFIG_PARTITION_TABLE_CUSTOM_FILENAME="partitions.csv"
CONFIG_SPIRAM=y
CONFIG_SPIRAM_MODE_QUAD=y
CONFIG_SPIRAM_SPEED_80M=y
CONFIG_ESP_MAIN_TASK_STACK_SIZE=8192
CONFIG_COMPILER_OPTIMIZATION_PERF=y
CONFIG_FREERTOS_HZ=1000
CONFIG_FREERTOS_ENABLE_BACKWARD_COMPATIBILITY=y
CONFIG_FREERTOS_TASK_CREATE_ALLOW_EXT_MEM=y
CONFIG_FATFS_LFN_HEAP=y
CONFIG_FATFS_API_ENCODING_UTF_8=y
CONFIG_FATFS_CODEPAGE_936=y
CONFIG_LV_FONT_MONTSERRAT_12=y
CONFIG_LV_FONT_MONTSERRAT_16=y
CONFIG_LV_FONT_MONTSERRAT_20=y
CONFIG_ESP_PLAYER_ENABLE_AUDIO=y
CONFIG_ESP_PLAYER_ENABLE_VIDEO=n
CONFIG_ESP_PLAYER_ENABLE_FILE_IO=y
# CONFIG_ESP_PLAYER_ENABLE_HTTP_IO is not set
# CONFIG_ESP_PLAYER_ENABLE_HLS_IO is not set
CONFIG_EXTRACTOR_CUSTOM_SUPPORT=n
CONFIG_AUDIO_ES_EXTRACTOR_SUPPORT=y
CONFIG_WAV_EXTRACTOR_SUPPORT=n
CONFIG_MP4_EXTRACTOR_SUPPORT=n
CONFIG_TS_EXTRACTOR_SUPPORT=n
CONFIG_OGG_EXTRACTOR_SUPPORT=n
CONFIG_AVI_EXTRACTOR_SUPPORT=n
CONFIG_CAF_EXTRACTOR_SUPPORT=n
CONFIG_FLV_EXTRACTOR_SUPPORT=n
CONFIG_AUDIO_DECODER_MP3_SUPPORT=y
CONFIG_AUDIO_DECODER_AAC_SUPPORT=n
CONFIG_AUDIO_DECODER_G711_SUPPORT=n
CONFIG_AUDIO_DECODER_G722_SUPPORT=n
CONFIG_AUDIO_DECODER_AMRNB_SUPPORT=n
CONFIG_AUDIO_DECODER_AMRWB_SUPPORT=n
CONFIG_AUDIO_DECODER_FLAC_SUPPORT=n
CONFIG_AUDIO_DECODER_VORBIS_SUPPORT=n
CONFIG_AUDIO_DECODER_OPUS_SUPPORT=n
CONFIG_AUDIO_DECODER_ADPCM_SUPPORT=n
CONFIG_AUDIO_DECODER_ALAC_SUPPORT=n
CONFIG_AUDIO_DECODER_PCM_SUPPORT=n
CONFIG_AUDIO_DECODER_SBC_SUPPORT=n
CONFIG_AUDIO_DECODER_LC3_SUPPORT=n
CONFIG_AUDIO_SIMPLE_DEC_WAV_SUPPORT=n
CONFIG_AUDIO_SIMPLE_DEC_M4A_SUPPORT=n
CONFIG_AUDIO_SIMPLE_DEC_TS_SUPPORT=n
CONFIG_AUDIO_SIMPLE_DEC_OGG_SUPPORT=n
CONFIG_AUDIO_ENCODER_AAC_SUPPORT=n
CONFIG_AUDIO_ENCODER_G711_SUPPORT=n
CONFIG_AUDIO_ENCODER_G722_SUPPORT=n
CONFIG_AUDIO_ENCODER_AMRNB_SUPPORT=n
CONFIG_AUDIO_ENCODER_AMRWB_SUPPORT=n
CONFIG_AUDIO_ENCODER_OPUS_SUPPORT=n
CONFIG_AUDIO_ENCODER_ADPCM_SUPPORT=n
CONFIG_AUDIO_ENCODER_ALAC_SUPPORT=n
CONFIG_AUDIO_ENCODER_PCM_SUPPORT=n
CONFIG_AUDIO_ENCODER_SBC_SUPPORT=n
CONFIG_AUDIO_ENCODER_LC3_SUPPORT=n
```
